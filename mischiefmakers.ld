SECTIONS
{
    __romPos = 0x0;
    . = __romPos;
    header_ROM_START = __romPos;
    header_VRAM = ADDR(.header);
    .header  : AT(header_ROM_START) SUBALIGN(16)
    {
        header_s = .;
        build/asm/header.s.o(.data);
    }
    header_ROM_END = 0x40;
    __romPos = 0x40;

    __romPos = 0x40;
    . = __romPos;
    boot_ROM_START = __romPos;
    boot_VRAM = ADDR(.boot);
    .boot  : AT(boot_ROM_START) SUBALIGN(16)
    {
        boot_bin = .;
        build/assets/boot.bin.o(.data);
    }
    boot_ROM_END = 0x1000;
    __romPos = 0x1000;

    __romPos = 0x1000;
    . = __romPos;
    main_ROM_START = __romPos;
    main_VRAM = ADDR(.main);
    .main 0x80000400 : AT(main_ROM_START) SUBALIGN(16)
    {
        boot_c = .;
        build/src/boot.c.o(.text);
        _5A70_s = .;
        build/asm/5A70.s.o(.text);
        A540_c = .;
        build/src/A540.c.o(.text);
        _11820_s = .;
        build/asm/11820.s.o(.text);
        _12DD0_c = .;
        build/src/12DD0.c.o(.text);
        _134E0_s = .;
        build/asm/134E0.s.o(.text);
        _13850_s = .;
        build/asm/13850.s.o(.text);
        _156F0_c = .;
        build/src/156F0.c.o(.text);
        _17A70_c = .;
        build/src/17A70.c.o(.text);
        _1E7A0_s = .;
        build/asm/1E7A0.s.o(.text);
        _1F1E0_c = .;
        build/src/1F1E0.c.o(.text);
        _22290_c = .;
        build/src/22290.c.o(.text);
        _241E0_c = .;
        build/src/241E0.c.o(.text);
        _438E0_c = .;
        build/src/438E0.c.o(.text);
        _48A30_s = .;
        build/asm/48A30.s.o(.text);
        _49200_c = .;
        build/src/49200.c.o(.text);
        _4FEB0_s = .;
        build/asm/4FEB0.s.o(.text);
        _59EA0_s = .;
        build/asm/59EA0.s.o(.text);
        _5D120_s = .;
        build/asm/5D120.s.o(.text);
        _5E230_s = .;
        build/asm/5E230.s.o(.text);
        _60CF0_s = .;
        build/asm/60CF0.s.o(.text);
        _61B80_s = .;
        build/asm/61B80.s.o(.text);
        _66250_s = .;
        build/asm/66250.s.o(.text);
        _7D8E0_s = .;
        build/asm/7D8E0.s.o(.text);
        _805E0_s = .;
        build/asm/805E0.s.o(.text);
        _80D90_s = .;
        build/asm/80D90.s.o(.text);
        _82920_s = .;
        build/asm/82920.s.o(.text);
        _82DB0_c = .;
        build/src/82DB0.c.o(.text);
        _82F80_s = .;
        build/asm/82F80.s.o(.text);
        _844E0_s = .;
        build/asm/844E0.s.o(.text);
        _84BB0_s = .;
        build/asm/84BB0.s.o(.text);
        _8D0A0_s = .;
        build/asm/8D0A0.s.o(.text);
        _8F080_s = .;
        build/asm/8F080.s.o(.text);
        _97770_s = .;
        build/asm/97770.s.o(.text);
        _99750_s = .;
        build/asm/99750.s.o(.text);
        _99A70_s = .;
        build/asm/99A70.s.o(.text);
        _99B50_s = .;
        build/asm/99B50.s.o(.text);
        _9A3C0_s = .;
        build/asm/9A3C0.s.o(.text);
        _9A820_s = .;
        build/asm/9A820.s.o(.text);
        _9A8F0_s = .;
        build/asm/9A8F0.s.o(.text);
        _9AC20_s = .;
        build/asm/9AC20.s.o(.text);
        _9B060_s = .;
        build/asm/9B060.s.o(.text);
        _9B250_s = .;
        build/asm/9B250.s.o(.text);
        _9B2F0_s = .;
        build/asm/9B2F0.s.o(.text);
        _9B5B0_s = .;
        build/asm/9B5B0.s.o(.text);
        _9B680_s = .;
        build/asm/9B680.s.o(.text);
        _9BAA0_s = .;
        build/asm/9BAA0.s.o(.text);
        _9BAD0_s = .;
        build/asm/9BAD0.s.o(.text);
        _9C5D0_s = .;
        build/asm/9C5D0.s.o(.text);
        _9C620_s = .;
        build/asm/9C620.s.o(.text);
        _9C730_s = .;
        build/asm/9C730.s.o(.text);
        _9C880_s = .;
        build/asm/9C880.s.o(.text);
        _9C8E0_s = .;
        build/asm/9C8E0.s.o(.text);
        _9CD50_s = .;
        build/asm/9CD50.s.o(.text);
        _9D020_s = .;
        build/asm/9D020.s.o(.text);
        _9EEA0_s = .;
        build/asm/9EEA0.s.o(.text);
        _9EEF0_s = .;
        build/asm/9EEF0.s.o(.text);
        _9F0D0_s = .;
        build/asm/9F0D0.s.o(.text);
        _9F140_s = .;
        build/asm/9F140.s.o(.text);
        _9FA70_s = .;
        build/asm/9FA70.s.o(.text);
        _9FA90_s = .;
        build/asm/9FA90.s.o(.text);
        A09A0_s = .;
        build/asm/A09A0.s.o(.text);
        A09F0_s = .;
        build/asm/A09F0.s.o(.text);
        A0B40_s = .;
        build/asm/A0B40.s.o(.text);
        A0BF0_s = .;
        build/asm/A0BF0.s.o(.text);
        A0C60_s = .;
        build/asm/A0C60.s.o(.text);
        A4D70_s = .;
        build/asm/A4D70.s.o(.text);
        A4DB0_s = .;
        build/asm/A4DB0.s.o(.text);
        A4E80_s = .;
        build/asm/A4E80.s.o(.text);
        A51F0_s = .;
        build/asm/A51F0.s.o(.text);
        A5270_s = .;
        build/asm/A5270.s.o(.text);
        A53C0_s = .;
        build/asm/A53C0.s.o(.text);
        A5510_s = .;
        build/asm/A5510.s.o(.text);
        A5810_s = .;
        build/asm/A5810.s.o(.text);
        A59F0_s = .;
        build/asm/A59F0.s.o(.text);
        A5AA0_s = .;
        build/asm/A5AA0.s.o(.text);
        A5D10_s = .;
        build/asm/A5D10.s.o(.text);
        A5DD0_s = .;
        build/asm/A5DD0.s.o(.text);
        A6240_s = .;
        build/asm/A6240.s.o(.text);
        A6310_s = .;
        build/asm/A6310.s.o(.text);
        A6320_s = .;
        build/asm/A6320.s.o(.text);
        A63F0_s = .;
        build/asm/A63F0.s.o(.text);
        A6830_s = .;
        build/asm/A6830.s.o(.text);
        A6930_s = .;
        build/asm/A6930.s.o(.text);
        A6A90_s = .;
        build/asm/A6A90.s.o(.text);
        A6AD0_s = .;
        build/asm/A6AD0.s.o(.text);
        A79B0_s = .;
        build/asm/A79B0.s.o(.text);
        A7A80_s = .;
        build/asm/A7A80.s.o(.text);
        A7B10_s = .;
        build/asm/A7B10.s.o(.text);
        A7B90_s = .;
        build/asm/A7B90.s.o(.text);
        A7C10_s = .;
        build/asm/A7C10.s.o(.text);
        A7C70_s = .;
        build/asm/A7C70.s.o(.text);
        A7D50_s = .;
        build/asm/A7D50.s.o(.text);
        A7E10_s = .;
        build/asm/A7E10.s.o(.text);
        A8410_s = .;
        build/asm/A8410.s.o(.text);
        A8440_s = .;
        build/asm/A8440.s.o(.text);
        A8460_s = .;
        build/asm/A8460.s.o(.text);
        A87F0_s = .;
        build/asm/A87F0.s.o(.text);
        A8900_s = .;
        build/asm/A8900.s.o(.text);
        A8A20_s = .;
        build/asm/A8A20.s.o(.text);
        A8B00_s = .;
        build/asm/A8B00.s.o(.text);
        A8CE0_s = .;
        build/asm/A8CE0.s.o(.text);
        A9080_s = .;
        build/asm/A9080.s.o(.text);
        A9550_s = .;
        build/asm/A9550.s.o(.text);
        A9860_s = .;
        build/asm/A9860.s.o(.text);
        A9A10_s = .;
        build/asm/A9A10.s.o(.text);
        A9D20_s = .;
        build/asm/A9D20.s.o(.text);
        AA700_s = .;
        build/asm/AA700.s.o(.text);
        AB380_s = .;
        build/asm/AB380.s.o(.text);
        AB440_s = .;
        build/asm/AB440.s.o(.text);
        AB520_s = .;
        build/asm/AB520.s.o(.text);
        AB610_s = .;
        build/asm/AB610.s.o(.text);
        AB990_s = .;
        build/asm/AB990.s.o(.text);
        ABB00_s = .;
        build/asm/ABB00.s.o(.text);
        ABC50_s = .;
        build/asm/ABC50.s.o(.text);
        ABE20_s = .;
        build/asm/ABE20.s.o(.text);
        ABE30_s = .;
        build/asm/ABE30.s.o(.text);
        ABE50_s = .;
        build/asm/ABE50.s.o(.text);
        AE340_s = .;
        build/asm/AE340.s.o(.text);
        AE7D0_s = .;
        build/asm/AE7D0.s.o(.text);
        AE8A0_s = .;
        build/asm/AE8A0.s.o(.text);
        AE9A0_s = .;
        build/asm/AE9A0.s.o(.text);
        AEA90_s = .;
        build/asm/AEA90.s.o(.text);
        AEB70_s = .;
        build/asm/AEB70.s.o(.text);
        AEED0_s = .;
        build/asm/AEED0.s.o(.text);
        AEF70_s = .;
        build/asm/AEF70.s.o(.text);
        AF0C0_s = .;
        build/asm/AF0C0.s.o(.text);
        AF1A0_s = .;
        build/asm/AF1A0.s.o(.text);
        AF2A0_s = .;
        build/asm/AF2A0.s.o(.text);
        AFEE0_s = .;
        build/asm/AFEE0.s.o(.text);
        B0110_s = .;
        build/asm/B0110.s.o(.text);
        B2BF0_s = .;
        build/asm/B2BF0.s.o(.text);
        B2DD0_s = .;
        build/asm/B2DD0.s.o(.text);
        B2E20_s = .;
        build/asm/B2E20.s.o(.text);
        B3340_s = .;
        build/asm/B3340.s.o(.text);
        B3660_s = .;
        build/asm/B3660.s.o(.text);
        B39A0_s = .;
        build/asm/B39A0.s.o(.text);
        B3BE0_s = .;
        build/asm/B3BE0.s.o(.text);
        B3E60_s = .;
        build/asm/B3E60.s.o(.text);
        B5510_s = .;
        build/asm/B5510.s.o(.text);
        B5600_s = .;
        build/asm/B5600.s.o(.text);
        B56B0_s = .;
        build/asm/B56B0.s.o(.text);
        B6010_s = .;
        build/asm/B6010.s.o(.text);
        B6130_s = .;
        build/asm/B6130.s.o(.text);
        B6180_s = .;
        build/asm/B6180.s.o(.text);
        B61F0_s = .;
        build/asm/B61F0.s.o(.text);
        B62A0_s = .;
        build/asm/B62A0.s.o(.text);
        B6380_s = .;
        build/asm/B6380.s.o(.text);
        B63E0_s = .;
        build/asm/B63E0.s.o(.text);
        B6440_s = .;
        build/asm/B6440.s.o(.text);
        B6500_s = .;
        build/asm/B6500.s.o(.text);
        B6590_s = .;
        build/asm/B6590.s.o(.text);
        B7280_s = .;
        build/asm/B7280.s.o(.text);
        B7DF0_s = .;
        build/asm/B7DF0.s.o(.text);
        B7E10_s = .;
        build/asm/B7E10.s.o(.text);
        B8850_s = .;
        build/asm/B8850.s.o(.text);
        B8900_s = .;
        build/asm/B8900.s.o(.text);
        B9B90_s = .;
        build/asm/B9B90.s.o(.text);
        B9EC0_s = .;
        build/asm/B9EC0.s.o(.text);
        BAD90_s = .;
        build/asm/BAD90.s.o(.text);
        BB260_s = .;
        build/asm/BB260.s.o(.text);
        BB310_s = .;
        build/asm/BB310.s.o(.text);
        BB3F0_s = .;
        build/asm/BB3F0.s.o(.text);
        BB5E0_s = .;
        build/asm/BB5E0.s.o(.text);
        BB810_bin = .;
        build/assets/BB810.bin.o(.data);
        boot_c = .;
        build/src/boot.c.o(.rodata);
    }
    main_ROM_END = 0xEB824;
    __romPos = 0xEB824;

    __romPos = 0xEB824;
    . = __romPos;
    EB824_ROM_START = __romPos;
    EB824_VRAM = ADDR(.EB824);
    .EB824  : AT(EB824_ROM_START) SUBALIGN(16)
    {
        EB824_bin = .;
        build/assets/EB824.bin.o(.data);
    }
    EB824_ROM_END = 0x800000;
    __romPos = 0x800000;

    /DISCARD/ :
    {
        *(*);
    }
}
